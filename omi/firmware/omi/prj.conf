## CMakeLists.txt
```
cmake_minimum_required(VERSION 3.20.0)
find_package(Zephyr REQUIRED HINTS $ENV{ZEPHYR_BASE})
enable_language(C ASM) # OPUS

project(omi)

file(GLOB app_sources
    src/main.c
    src/mic.c
    src/battery.c
    src/led.c
    src/haptic.c
    src/sd_card.c
    src/spi_flash.c
    src/settings.c
    src/feedback.c
    src/wdog_facade.c
    src/rtc.c
    src/imu.c
)

if(CONFIG_OMI_ENABLE_T5838_AAD)
    # Hardware AAD is integrated into mic.c; t5838_aad.c is the low-level driver.
    list(APPEND app_sources src/t5838_aad.c)
endif()
file(GLOB core_sources
    src/lib/core/aad_hold_policy.c
    src/lib/core/audio_storage_packer.c
    src/lib/core/button_hold_policy.c
    src/lib/core/mic_read_recovery.c
    src/lib/core/config.h
    src/lib/core/codec.c
    src/lib/core/ring_transfer_integrity.c
    src/lib/core/rtc_elapsed_recovery.c
    src/lib/core/rtc_time_state.c
    src/lib/core/sd_ring_durability.c
    src/lib/core/sd_ring_recovery.c
    src/lib/core/sd_write_recovery.c
    src/lib/core/storage_readiness.c
    src/lib/core/voice_activity_gate.c
    src/lib/core/voice_capture_policy.c
    src/lib/core/transport.c
    src/lib/core/button_service.c
    src/lib/core/monitor.c
)

if(CONFIG_OMI_ENABLE_BUTTON_INPUT)
    list(APPEND core_sources src/lib/core/button.c)
endif()

if(CONFIG_OMI_ENABLE_BLACKBOX_DIAGNOSTICS)
    list(APPEND core_sources
        src/lib/core/blackbox.c
        src/lib/core/blackbox_trace.c
    )
endif()

if(CONFIG_OMI_ENABLE_OFFLINE_STORAGE)
    list(APPEND core_sources src/lib/core/storage.c)
endif()

target_sources(app PRIVATE ${core_sources} ${app_sources})
target_include_directories(app PRIVATE
    ${CMAKE_CURRENT_SOURCE_DIR}/src
    ${CMAKE_CURRENT_SOURCE_DIR}/src/lib/core
)

if(CONFIG_OMI_CODEC_OPUS)
    add_subdirectory(src/lib/core/lib/opus-1.2.1/)
    target_link_libraries(app PRIVATE opus_codec)
endif()
```

## Kconfig
```
source "Kconfig.zephyr"

menu "Omi Features Configuration"

config OMI_CODEC_OPUS
    bool "Opus Audio Codec"
    help
        "Enable the Opus audio codec support."
    default n

config OMI_ENABLE_OFFLINE_STORAGE
	bool "Offline SD Card Storage"
    help
        "Enable the offline storage support. Requires a SD Card."
	default n

config OMI_STORAGE_AUTHORITATIVE_CAPTURE
    bool "Store every audio frame before optional live BLE preview"
    depends on OMI_ENABLE_OFFLINE_STORAGE
    default n
    help
        Make the SD ring the authoritative capture path whether or not a phone
        is connected. A frame may be sent as live BLE preview only after the
        storage packer accepts it. Temporary storage backpressure retains the
        frame in order; terminal storage failure may still fall back to live
        BLE so capture does not fail on both paths.

config OMI_STORAGE_AUTHORITATIVE_LIVE_PREVIEW
    bool "Send live BLE preview after local storage ownership"
    depends on OMI_STORAGE_AUTHORITATIVE_CAPTURE
    default n
    help
        Preserve Omi's low-latency live stream after each frame is accepted by
        the local storage path. Leave this disabled until the app can dedupe a
        live frame against the same frame recovered from the SD ring.

config OMI_ENABLE_ACCELEROMETER
    bool "Accelerometer Support"
    help
        "Enable the accelerometer support."
    default n

config OMI_ENABLE_BUTTON
    bool "Button support"
    help
        "Enable the software button support."
    default n

config OMI_ENABLE_BUTTON_INPUT
    bool "Physical button input"
    depends on OMI_ENABLE_BUTTON
    default y

config OMI_ENABLE_SPEAKER
    bool "Enable the speaker"
    help
        "Enable the speaker support."
    default n

config OMI_ENABLE_BATTERY
    bool "Enable the battery"
    help
        "Enable the battery support."
    default n

config OMI_ENABLE_USB
    bool "Enable the usb"
    help
        "Enable the USB power check support."
    default n

config OMI_ENABLE_HAPTIC
    bool "Enable the haptic"
    help
        "Enable the haptic support."
    default n

config OMI_ENABLE_RFSW_CTRL
    bool "Enable RFSwitch Control"
    help
        "Enable RFSwitch Control support."
    default y

config OMI_ENABLE_MONITOR
    bool "Enable monitoring/metrics system"
    help
        "Enable the monitoring system for debugging and metrics collection.
         Disable in production to save power, RAM, and flash space."
    default n

config OMI_ENABLE_VAD_GATE
    bool "Enable software acoustic activity observer"
    help
        "Observe microphone amplitude for the hardware-AAD power policy.
         Captured audio is always forwarded to codec/storage while PDM is
         awake."
    default n

config OMI_VAD_ABS_THRESHOLD
    int "VAD minimum average absolute amplitude threshold"
    range 1 32767
    default 600
    depends on OMI_ENABLE_VAD_GATE
    help
        "Lower bound for the adaptive voice threshold. The effective threshold
         is the larger of this value and the learned ambient noise floor plus
         OMI_VAD_NOISE_MARGIN."

config OMI_VAD_NOISE_MARGIN
    int "VAD amplitude margin above learned ambient noise"
    range 1 32767
    default 200
    depends on OMI_ENABLE_VAD_GATE
    help
        "Average absolute amplitude required above the adaptive ambient noise
         floor. This keeps microphone-gain and room-noise changes from turning
         into continuous false activity while the minimum threshold protects
         immediate speech at boot."

config OMI_VAD_NOISE_RISE_SHIFT
    int "VAD ambient rise smoothing shift"
    range 1 15
    default 4
    depends on OMI_ENABLE_VAD_GATE
    help
        "Closed-gate ambient estimates rise by 1/(2^N) of the remaining
         difference per 100 ms frame. Default 4 adapts upward over seconds
         without immediately learning a transient as the noise floor."

config OMI_VAD_NOISE_FALL_SHIFT
    int "VAD ambient fall smoothing shift"
    range 1 15
    default 2
    depends on OMI_ENABLE_VAD_GATE
    help
        "Closed-gate ambient estimates fall by 1/(2^N) of the remaining
         difference per 100 ms frame. Default 2 recovers sensitivity quickly
         when the wearer moves into a quieter room."

config OMI_VAD_DEBOUNCE_FRAMES
    int "VAD debounce frames to promote conversation hold"
    range 1 50
    default 3
    depends on OMI_ENABLE_VAD_GATE
    help
        "Number of consecutive frames above threshold required before the
         hardware-AAD policy selects its conversation hold. Each frame is
         ~100ms. Default 3 = 300ms debounce to filter noise spikes."

config OMI_VAD_HOLD_MS
    int "VAD observer hold time after last activity (ms)"
    range 500 30000
    default 3000
    depends on OMI_ENABLE_VAD_GATE
    help
        "Time in milliseconds to keep the software activity state open after
         the last active frame. Capture continues regardless of this state."

config OMI_ENABLE_T5838_AAD
    bool "Enable T5838 hardware AAD (ultra-low-power mic sleep)"
    depends on OMI_ENABLE_VAD_GATE
    default n
    help
        "After the software observer's idle or conversation hold expires,
         pause the PDM clock so the T5838 MEMS microphone enters its built-in
         Acoustic Activity Detection mode (~15 µA). The mic hardware monitors
         sound and asserts WAKE to resume PDM. Requires THSEL (P1.5) and WAKE
         (P1.2) to be wired to the T5838."

config OMI_AAD_SETTLE_MS
    int "T5838 AAD settle time before arming WAKE (ms)"
    range 100 3000
    default 800
    depends on OMI_ENABLE_T5838_AAD
    help
        "Time to wait after clocking the T5838 into hardware AAD sleep before
         arming the WAKE interrupt. Lets the mic settle its noise floor and
         swallow the entry transient so it does not immediately false-wake."

config OMI_AAD_IDLE_HOLD_MS
    int "T5838 AAD hold before any conversation (ms)"
    range 500 30000
    default 5000
    depends on OMI_ENABLE_T5838_AAD
    help
        "How long to monitor with software VAD after boot or a hardware AAD
         wake that does not become speech before returning to low-power AAD."

config OMI_AAD_CONVERSATION_HOLD_MS
    int "T5838 AAD hold after detected conversation speech (ms)"
    range 10000 300000
    default 120000
    depends on OMI_ENABLE_T5838_AAD
    help
        "Keep the microphone available for cheap software VAD after speech so
         a continuing conversation resumes without hardware sleep churn.
         Opus and SD remain gated during pauses; default 120000 matches the
         app's two-minute conversation boundary."

config OMI_WATCHDOG_TIMEOUT_MS
    int "Watchdog timeout (ms)"
    range 5000 300000
    default 30000
    help
        "Watchdog reset timeout in milliseconds. Increase this when boot-time
         operations can run longer (e.g. SD/LFS pre-warm) to avoid false
         watchdog resets."

endmenu
```

## prj.conf
```kconfig
CONFIG_SERIAL=y

CONFIG_GPIO=y
CONFIG_INPUT=y
CONFIG_I2C=y
# CONFIG_I2C_SHELL=y
CONFIG_SPI=y
CONFIG_SPI_NOR=y
# CONFIG_SPI_SHELL=y
CONFIG_SETTINGS=y
CONFIG_SETTINGS_NVS=y
CONFIG_NVS=y

CONFIG_PM_DEVICE=y
# CONFIG_PM_DEVICE_RUNTIME=y
CONFIG_ADC=y
CONFIG_ADC_ASYNC=y
CONFIG_ADC_NRFX_SAADC=y
CONFIG_AUDIO=y
CONFIG_AUDIO_DMIC=y
CONFIG_FLASH=y
CONFIG_FLASH_JESD216_API=y
CONFIG_DISK_DRIVER_SDMMC=y
CONFIG_SENSOR=y
CONFIG_REGULATOR=y
CONFIG_ENTROPY_GENERATOR=y

CONFIG_BT=y
CONFIG_BT_SMP=y
CONFIG_BT_PERIPHERAL=y
CONFIG_BT_DIS=n
CONFIG_BT_BAS=n
# CONFIG_BT_DEVICE_NAME="OMI" # configurated bellow
# CONFIG_BT_DEVICE_APPEARANCE=768 # TODO: conflict
CONFIG_CBPRINTF_FP_SUPPORT=y

CONFIG_NCS_SAMPLE_MCUMGR_BT_OTA_DFU=y
CONFIG_MCUMGR_GRP_IMG_ALLOW_ERASE_PENDING=y
# BT NUS shell: controlled by CONFIG_OMI_ENABLE_BT_LOG
CONFIG_SHELL=n
CONFIG_SHELL_BT_NUS=n
CONFIG_SHELL_BT_NUS_LOG_LEVEL_INF=n
CONFIG_SHELL_LOG_BACKEND=n
# CONFIG_SHELL_BACKEND_DUMMY=y

CONFIG_POWEROFF=y

# CONFIG_T5838_LOG_LEVEL_DBG=y
# CONFIG_T5838_AAD_TRIGGER=y

# file system
# CONFIG_MAIN_STACK_SIZE=2048
CONFIG_FILE_SYSTEM=y
# CONFIG_FILE_SYSTEM_EXT2=y

# LittleFS formats itself on first mount - no explicit mkfs needed
# CONFIG_FILE_SYSTEM_MKFS is not set
# CONFIG_FS_FATFS_MKFS is not set
# CONFIG_TEST_RANDOM_GENERATOR=y

CONFIG_DISK_ACCESS=y
CONFIG_DISK_DRIVER_SDMMC=y

# FAT filesystem automatically detects partitions
# CONFIG_EXT2_DISK_STARTING_SECTOR=2082

# Memories
CONFIG_MAIN_STACK_SIZE=4096
CONFIG_SYSTEM_WORKQUEUE_STACK_SIZE=4096

# Kernel options
CONFIG_ENTROPY_GENERATOR=y
CONFIG_POSIX_CLOCK=y

CONFIG_INIT_STACKS=y
CONFIG_HEAP_MEM_POOL_SIZE=40000

#
# Hardware settings
#

CONFIG_PWM=y
CONFIG_GPIO=y
CONFIG_ADC=y

#
# Audio (new)
#
CONFIG_I2S=y
CONFIG_I2S_NRFX=y
CONFIG_SPI_NRFX=y
CONFIG_AUDIO=y
CONFIG_AUDIO_DMIC=y
CONFIG_AUDIO_DMIC_NRFX_PDM=y
CONFIG_NRFX_PDM0=y  # PDM microphone

# Watchdog Timer
CONFIG_WATCHDOG=y
CONFIG_WDT_DISABLE_AT_BOOT=n

# To flash via dev board
#CONFIG_BUILD_OUTPUT_UF2=n
#CONFIG_USE_DT_CODE_PARTITION=n

#
# Bluetooth settings
#

CONFIG_BT=y
CONFIG_BT_PERIPHERAL=y
CONFIG_BT_MAX_CONN=1
# CONFIG_BT_EXT_ADV_MAX_ADV_SET=2
CONFIG_BT_MAX_PAIRED=1
CONFIG_BT_DEVICE_APPEARANCE=22
CONFIG_BT_GATT_DYNAMIC_DB=y

#
# Max transmit power supported by nRF52840
#

CONFIG_BT_CTLR_TX_PWR_ANTENNA=8
CONFIG_BT_PHY_UPDATE=y

#
# Battery and Device Information services
#

CONFIG_BT_BAS=y
CONFIG_BT_DIS=y
CONFIG_BT_DIS_PNP=n
CONFIG_BT_DEVICE_NAME="Omi"
CONFIG_BT_DIS_MODEL="Omi CV 1"
CONFIG_BT_DIS_MANUF="Based Hardware"
CONFIG_BT_DIS_FW_REV=y
CONFIG_BT_DIS_HW_REV=y
CONFIG_BT_DIS_FW_REV_STR="3.0.30"
CONFIG_MCUBOOT_IMGTOOL_SIGN_VERSION="3.0.30+110"
CONFIG_BT_DIS_HW_REV_STR="5.0"

#
# Large BLE packets / BLE Buffers
#
# CONFIG_BT_GATT_CLIENT=y
# CONFIG_BT_THROUGHPUT=y

CONFIG_BT_L2CAP_TX_MTU=498

CONFIG_BT_CTLR_DATA_LENGTH_MAX=251
CONFIG_BT_CTLR_PHY_2M=y
CONFIG_BT_CTLR_PHY_CODED=y
CONFIG_BT_CTLR_SDC_MAX_CONN_EVENT_LEN_DEFAULT=400000
CONFIG_BT_CONN_TX_MAX=20
CONFIG_BT_L2CAP_TX_BUF_COUNT=20
CONFIG_BT_BUF_ACL_RX_SIZE=1024
CONFIG_BT_BUF_ACL_TX_SIZE=502
CONFIG_BT_BUF_ACL_TX_COUNT=10
CONFIG_BT_ATT_TX_COUNT=20
# CONFIG_BT_EXT_ADV=y
# CONFIG_BT_PER_ADV=y
# CONFIG_BT_OBSERVER=y
# CONFIG_BT_ATT_PREPARE_COUNT=2
CONFIG_BT_USER_DATA_LEN_UPDATE=y
CONFIG_BT_USER_PHY_UPDATE=y
CONFIG_BT_AUTO_DATA_LEN_UPDATE=y
CONFIG_BT_AUTO_PHY_UPDATE=y
CONFIG_BT_GATT_AUTO_UPDATE_MTU=y

CONFIG_BT_GATT_CLIENT=y

# Link setup requests these once, after connect, in the staged worker. Disable
# the host's second automatic request so Android/iOS do not see duplicate HCI
# parameter churn during service discovery.
CONFIG_BT_GAP_AUTO_UPDATE_CONN_PARAMS=n

# Stability-first preferred connection parameters (15-30ms).
CONFIG_BT_PERIPHERAL_PREF_MIN_INT=12
CONFIG_BT_PERIPHERAL_PREF_MAX_INT=24
CONFIG_BT_PERIPHERAL_PREF_LATENCY=0
# 6 seconds
CONFIG_BT_PERIPHERAL_PREF_TIMEOUT=600

CONFIG_FPU=y
CONFIG_NORDIC_QSPI_NOR=y
CONFIG_BOARD_ENABLE_DCDC_APP=y
CONFIG_BOARD_ENABLE_DCDC_NET=y

#
# Console
#
# Y to enable console log
CONFIG_CONSOLE=y
CONFIG_PRINTK=y
CONFIG_UART_CONSOLE=y
# CONFIG_SHELL_BACKEND_SERIAL=y

# Keep release output minimal: only explicit printk() lines.
CONFIG_LOG=n

#
# Logs
#

## Enable the lines below to enable logs via UART/USB
# CONFIG_LOG=y
# CONFIG_LOG_PRINTK=y
# CONFIG_UART_CONSOLE=y
# CONFIG_LOG_PROCESS_THREAD_PRIORITY=5
# CONFIG_LOG_PROCESS_THREAD_CUSTOM_PRIORITY=y
#
# CONFIG_LOG_MODE_IMMEDIATE=y
# CONFIG_SENSOR_LOG_LEVEL_DBG=y
# CONFIG_FLASH_LOG_LEVEL_DBG=y
# CONFIG_FS_LOG_LEVEL_DBG=y


#
# Enable logging (set level to DBG=4, INF=3, WRN=2, ERR=1)
# CONFIG_LOG_DEFAULT_LEVEL=3

#
# Log level and buffer size
#

# CONFIG_LOG_OVERRIDE_LEVEL=4
# CONFIG_LOG_BUFFER_SIZE=32000
# CONFIG_LOG_PROCESS_THREAD_STACK_SIZE=4096

#
# Debug
#

# CONFIG_DEBUG=y
# CONFIG_DEBUG_OPTIMIZATIONS=y
# CONFIG_SERIAL=y

#
# Debug (This value breaks some builds)
#

# CONFIG_ASSERT=y

#
# BT log configuration
#

# CONFIG_BT_DEBUG_LOG=y
# CONFIG_BT_L2CAP_LOG_LEVEL_DBG=y
# CONFIG_BT_LOG_LEVEL_DBG=y

# CONFIG_BT_RX_STACK_SIZE=4096
# CONFIG_BT_CTLR_RX_PRIO_STACK_SIZE=4096
# CONFIG_BT_DEBUG_LOG=y
# CONFIG_BT_RX_STACK_SIZE=4096
# CONFIG_BT_CTLR_RX_PRIO_STACK_SIZE=4096

#
# SD Card Support (all devices required)
#

CONFIG_DISK_ACCESS=y
CONFIG_FILE_SYSTEM=y

# LittleFS for SD NAND (power-loss safe, no FAT dirty-bit issues)
CONFIG_FILE_SYSTEM_LITTLEFS=y

# FAT disabled - SD NAND + FATFS is unstable (no wear leveling, power-loss unsafe)
# CONFIG_FAT_FILESYSTEM_ELM is not set
# CONFIG_FS_FATFS_MOUNT_MKFS is not set
CONFIG_MAIN_STACK_SIZE=4096
CONFIG_DISK_DRIVER_SDMMC=y
# CONFIG_SPI=y
# CONFIG_HEAP_MEM_POOL_SIZE=512 # disabled by conflicting

#
# Disable unused peripherals
#
CONFIG_I2C=n
# CONFIG_NRFX_TWIM0=n
# CONFIG_NRFX_TWIM1=n

#
# LSM6DSL sensor (accelerometer and gyroscope)
#
CONFIG_LSM6DSL=y
CONFIG_LSM6DSL_ENABLE_TEMP=n
# CONFIG_LSM6DSL_TRIGGER_GLOBAL_THREAD=y
CONFIG_SENSOR=y

#
# Speaker
#
CONFIG_I2S=y
CONFIG_I2S_NRFX=y
CONFIG_SPI_NRFX=y

#
# NFC (in the future)
#

# CONFIG_NFC_T2T_NRFXLIB=y
# CONFIG_NFC_NDEF=y
# CONFIG_NFC_NDEF_MSG=y
# CONFIG_NFC_NDEF_RECORD=y
# CONFIG_NFC_NDEF_URI_MSG=y
# CONFIG_NFC_NDEF_URI_REC=y
# CONFIG_HWINFO=y

#
#EVERYTHING ELSE
#

CONFIG_RING_BUFFER=y

CONFIG_PM_DEVICE=y
# CONFIG_NRFX_USBD=y

# CONFIG_FLASH=y
#

#
# OMI features configuration
#
CONFIG_OMI_CODEC_OPUS=y
CONFIG_OMI_ENABLE_OFFLINE_STORAGE=y
# Experimental Plaud-style capture: SD is authoritative and BLE is control/
# backlog transport. Keep live preview off until app-side sequence dedupe lands.
CONFIG_OMI_STORAGE_AUTHORITATIVE_CAPTURE=y
CONFIG_OMI_STORAGE_AUTHORITATIVE_LIVE_PREVIEW=n
CONFIG_OMI_ENABLE_ACCELEROMETER=n
CONFIG_OMI_ENABLE_BUTTON=y
CONFIG_OMI_ENABLE_SPEAKER=n
CONFIG_OMI_ENABLE_BATTERY=y
CONFIG_OMI_ENABLE_USB=n
CONFIG_OMI_ENABLE_HAPTIC=y
CONFIG_OMI_ENABLE_RFSW_CTRL=y
CONFIG_OMI_ENABLE_MONITOR=n
CONFIG_OMI_ENABLE_BLACKBOX_DIAGNOSTICS=y
CONFIG_OMI_ENABLE_VAD_GATE=y
# The adaptive observer controls only T5838 AAD power hold. Every PCM frame
# captured while PDM is awake still reaches Opus and the authoritative SD ring.
CONFIG_OMI_VAD_ABS_THRESHOLD=250
CONFIG_OMI_VAD_NOISE_MARGIN=100
CONFIG_OMI_VAD_NOISE_RISE_SHIFT=4
CONFIG_OMI_VAD_NOISE_FALL_SHIFT=2
CONFIG_OMI_VAD_DEBOUNCE_FRAMES=3
CONFIG_OMI_VAD_HOLD_MS=2000
CONFIG_OMI_ENABLE_T5838_AAD=y
CONFIG_OMI_AAD_SETTLE_MS=800
CONFIG_OMI_AAD_IDLE_HOLD_MS=5000
CONFIG_OMI_AAD_CONVERSATION_HOLD_MS=120000
```

## omi.conf
```kconfig
CONFIG_SERIAL=y

CONFIG_GPIO=y
CONFIG_INPUT=y
CONFIG_I2C=y
# CONFIG_I2C_SHELL=y
CONFIG_SPI=y
CONFIG_SPI_NOR=y
# CONFIG_SPI_SHELL=y
CONFIG_SETTINGS=y
CONFIG_SETTINGS_NVS=y
CONFIG_NVS=y

CONFIG_PM_DEVICE=y
# CONFIG_PM_DEVICE_RUNTIME=y
CONFIG_ADC=y
CONFIG_ADC_ASYNC=y
CONFIG_ADC_NRFX_SAADC=y
CONFIG_AUDIO=y
CONFIG_AUDIO_DMIC=y
CONFIG_FLASH=y
CONFIG_FLASH_JESD216_API=y
CONFIG_DISK_DRIVER_SDMMC=y
CONFIG_SENSOR=y
CONFIG_REGULATOR=y
CONFIG_ENTROPY_GENERATOR=y

CONFIG_BT=y
CONFIG_BT_SMP=y
CONFIG_BT_PERIPHERAL=y
CONFIG_BT_DIS=n
CONFIG_BT_BAS=n
# CONFIG_BT_DEVICE_NAME="OMI" # configurated bellow
# CONFIG_BT_DEVICE_APPEARANCE=768 # TODO: conflict
CONFIG_CBPRINTF_FP_SUPPORT=y

CONFIG_NCS_SAMPLE_MCUMGR_BT_OTA_DFU=y
CONFIG_MCUMGR_GRP_IMG_ALLOW_ERASE_PENDING=y
# BT NUS shell: controlled by CONFIG_OMI_ENABLE_BT_LOG
CONFIG_SHELL=n
CONFIG_SHELL_BT_NUS=n
CONFIG_SHELL_BT_NUS_LOG_LEVEL_INF=n
CONFIG_SHELL_LOG_BACKEND=n
# CONFIG_SHELL_BACKEND_DUMMY=y

CONFIG_POWEROFF=y

# CONFIG_T5838_LOG_LEVEL_DBG=y
# CONFIG_T5838_AAD_TRIGGER=y

# file system
# CONFIG_MAIN_STACK_SIZE=2048
CONFIG_FILE_SYSTEM=y
# CONFIG_FILE_SYSTEM_EXT2=y

# LittleFS formats itself on first mount - no explicit mkfs needed
# CONFIG_FILE_SYSTEM_MKFS is not set
# CONFIG_FS_FATFS_MKFS is not set
# CONFIG_TEST_RANDOM_GENERATOR=y

CONFIG_DISK_ACCESS=y
CONFIG_DISK_DRIVER_SDMMC=y

# FAT filesystem automatically detects partitions
# CONFIG_EXT2_DISK_STARTING_SECTOR=2082

# Memories
CONFIG_MAIN_STACK_SIZE=4096
CONFIG_SYSTEM_WORKQUEUE_STACK_SIZE=4096

# Kernel options
CONFIG_ENTROPY_GENERATOR=y
CONFIG_POSIX_CLOCK=y

CONFIG_INIT_STACKS=y
CONFIG_HEAP_MEM_POOL_SIZE=40000

#
# Hardware settings
#

CONFIG_PWM=y
CONFIG_GPIO=y
CONFIG_ADC=y

#
# Audio (new)
#
CONFIG_I2S=y
CONFIG_I2S_NRFX=y
CONFIG_SPI_NRFX=y
CONFIG_AUDIO=y
CONFIG_AUDIO_DMIC=y
CONFIG_AUDIO_DMIC_NRFX_PDM=y
CONFIG_NRFX_PDM0=y  # PDM microphone

# Watchdog Timer
CONFIG_WATCHDOG=y
CONFIG_WDT_DISABLE_AT_BOOT=n

# To flash via dev board
#CONFIG_BUILD_OUTPUT_UF2=n
#CONFIG_USE_DT_CODE_PARTITION=n

#
# Bluetooth settings
#

CONFIG_BT=y
CONFIG_BT_PERIPHERAL=y
CONFIG_BT_MAX_CONN=1
# CONFIG_BT_EXT_ADV_MAX_ADV_SET=2
CONFIG_BT_MAX_PAIRED=1
CONFIG_BT_DEVICE_APPEARANCE=22
CONFIG_BT_GATT_DYNAMIC_DB=y

#
# Max transmit power supported by nRF52840
#

CONFIG_BT_CTLR_TX_PWR_ANTENNA=8
CONFIG_BT_PHY_UPDATE=y

#
# Battery and Device Information services
#

CONFIG_BT_BAS=y
CONFIG_BT_DIS=y
CONFIG_BT_DIS_PNP=n
CONFIG_BT_DEVICE_NAME="Omi"
CONFIG_BT_DIS_MODEL="Omi CV 1"
CONFIG_BT_DIS_MANUF="Based Hardware"
CONFIG_BT_DIS_FW_REV=y
CONFIG_BT_DIS_HW_REV=y
CONFIG_BT_DIS_FW_REV_STR="3.0.30"
CONFIG_MCUBOOT_IMGTOOL_SIGN_VERSION="3.0.30+101"
CONFIG_BT_DIS_HW_REV_STR="5.0"

#
# Large BLE packets / BLE Buffers 
#
# CONFIG_BT_GATT_CLIENT=y
# CONFIG_BT_THROUGHPUT=y

CONFIG_BT_L2CAP_TX_MTU=498

CONFIG_BT_CTLR_DATA_LENGTH_MAX=251
CONFIG_BT_CTLR_PHY_2M=y
CONFIG_BT_CTLR_PHY_CODED=y
CONFIG_BT_CTLR_SDC_MAX_CONN_EVENT_LEN_DEFAULT=400000
CONFIG_BT_CONN_TX_MAX=20
CONFIG_BT_L2CAP_TX_BUF_COUNT=20
CONFIG_BT_BUF_ACL_RX_SIZE=1024
CONFIG_BT_BUF_ACL_TX_SIZE=502
CONFIG_BT_BUF_ACL_TX_COUNT=10
CONFIG_BT_ATT_TX_COUNT=20
# CONFIG_BT_EXT_ADV=y
# CONFIG_BT_PER_ADV=y
# CONFIG_BT_OBSERVER=y
# CONFIG_BT_ATT_PREPARE_COUNT=2
CONFIG_BT_USER_DATA_LEN_UPDATE=y
CONFIG_BT_USER_PHY_UPDATE=y
CONFIG_BT_AUTO_DATA_LEN_UPDATE=y
CONFIG_BT_AUTO_PHY_UPDATE=y
CONFIG_BT_GATT_AUTO_UPDATE_MTU=y

CONFIG_BT_GATT_CLIENT=y

# Link setup requests these once, after connect, in the staged worker. Disable
# the host's second automatic request so Android/iOS do not see duplicate HCI
# parameter churn during service discovery.
CONFIG_BT_GAP_AUTO_UPDATE_CONN_PARAMS=n

# Stability-first preferred connection parameters (15-30ms).
CONFIG_BT_PERIPHERAL_PREF_MIN_INT=12
CONFIG_BT_PERIPHERAL_PREF_MAX_INT=24
CONFIG_BT_PERIPHERAL_PREF_LATENCY=0
# 6 seconds
CONFIG_BT_PERIPHERAL_PREF_TIMEOUT=600

CONFIG_FPU=y
CONFIG_NORDIC_QSPI_NOR=y
CONFIG_BOARD_ENABLE_DCDC_APP=y
CONFIG_BOARD_ENABLE_DCDC_NET=y

#
# Console
#
# Y to enable console log
CONFIG_CONSOLE=y
CONFIG_PRINTK=y
CONFIG_UART_CONSOLE=y
# CONFIG_SHELL_BACKEND_SERIAL=y

# Keep release output minimal: only explicit printk() lines.
CONFIG_LOG=n

#
# Logs
#

## Enable the lines below to enable logs via UART/USB
# CONFIG_LOG=y
# CONFIG_LOG_PRINTK=y
# CONFIG_UART_CONSOLE=y
# CONFIG_LOG_PROCESS_THREAD_PRIORITY=5
# CONFIG_LOG_PROCESS_THREAD_CUSTOM_PRIORITY=y
#
# CONFIG_LOG_MODE_IMMEDIATE=y
# CONFIG_SENSOR_LOG_LEVEL_DBG=y
# CONFIG_FLASH_LOG_LEVEL_DBG=y
# CONFIG_FS_LOG_LEVEL_DBG=y


#
# Enable logging (set level to DBG=4, INF=3, WRN=2, ERR=1)
# CONFIG_LOG_DEFAULT_LEVEL=3

#
# Log level and buffer size
#

# CONFIG_LOG_OVERRIDE_LEVEL=4
# CONFIG_LOG_BUFFER_SIZE=32000
# CONFIG_LOG_PROCESS_THREAD_STACK_SIZE=4096

#
# Debug
#

# CONFIG_DEBUG=y
# CONFIG_DEBUG_OPTIMIZATIONS=y
# CONFIG_SERIAL=y

#
# Debug (This value breaks some builds)
#

# CONFIG_ASSERT=y

#
# BT log configuration
#

# CONFIG_BT_DEBUG_LOG=y
# CONFIG_BT_L2CAP_LOG_LEVEL_DBG=y
# CONFIG_BT_LOG_LEVEL_DBG=y

# CONFIG_BT_RX_STACK_SIZE=4096
# CONFIG_BT_CTLR_RX_PRIO_STACK_SIZE=4096
# CONFIG_BT_DEBUG_LOG=y
# CONFIG_BT_RX_STACK_SIZE=4096
# CONFIG_BT_CTLR_RX_PRIO_STACK_SIZE=4096

#
# SD Card Support (all devices required)
#

CONFIG_DISK_ACCESS=y
CONFIG_FILE_SYSTEM=y

# LittleFS for SD NAND (power-loss safe, no FAT dirty-bit issues)
CONFIG_FILE_SYSTEM_LITTLEFS=y

# FAT disabled - SD NAND + FATFS is unstable (no wear leveling, power-loss unsafe)
# CONFIG_FAT_FILESYSTEM_ELM is not set
# CONFIG_FS_FATFS_MOUNT_MKFS is not set
CONFIG_MAIN_STACK_SIZE=4096
CONFIG_DISK_DRIVER_SDMMC=y
# CONFIG_SPI=y
# CONFIG_HEAP_MEM_POOL_SIZE=512 # disabled by conflicting

#
# Disable unused peripherals
#
CONFIG_I2C=n
# CONFIG_NRFX_TWIM0=n
# CONFIG_NRFX_TWIM1=n

#
# LSM6DSL sensor (accelerometer and gyroscope)
#
CONFIG_LSM6DSL=y
CONFIG_LSM6DSL_ENABLE_TEMP=n
# CONFIG_LSM6DSL_TRIGGER_GLOBAL_THREAD=y
CONFIG_SENSOR=y

#
# Speaker
#
CONFIG_I2S=y
CONFIG_I2S_NRFX=y
CONFIG_SPI_NRFX=y

#
# NFC (in the future)
#

# CONFIG_NFC_T2T_NRFXLIB=y
# CONFIG_NFC_NDEF=y
# CONFIG_NFC_NDEF_MSG=y
# CONFIG_NFC_NDEF_RECORD=y
# CONFIG_NFC_NDEF_URI_MSG=y
# CONFIG_NFC_NDEF_URI_REC=y
# CONFIG_HWINFO=y

#
#EVERYTHING ELSE
#

CONFIG_RING_BUFFER=y

CONFIG_PM_DEVICE=y
# CONFIG_NRFX_USBD=y

# CONFIG_FLASH=y
#

#
# OMI features configuration
#
CONFIG_OMI_CODEC_OPUS=y
CONFIG_OMI_ENABLE_OFFLINE_STORAGE=y
# Experimental Plaud-style capture: SD is authoritative and BLE is control/
# backlog transport. Keep live preview off until app-side sequence dedupe lands.
CONFIG_OMI_STORAGE_AUTHORITATIVE_CAPTURE=y
CONFIG_OMI_STORAGE_AUTHORITATIVE_LIVE_PREVIEW=n
CONFIG_OMI_ENABLE_ACCELEROMETER=n
CONFIG_OMI_ENABLE_BUTTON=y
CONFIG_OMI_ENABLE_SPEAKER=n
CONFIG_OMI_ENABLE_BATTERY=y
CONFIG_OMI_ENABLE_USB=n
CONFIG_OMI_ENABLE_HAPTIC=y
CONFIG_OMI_ENABLE_RFSW_CTRL=y
CONFIG_OMI_ENABLE_MONITOR=n
CONFIG_OMI_ENABLE_BLACKBOX_DIAGNOSTICS=y
CONFIG_OMI_ENABLE_VAD_GATE=y
# The adaptive observer controls only T5838 AAD power hold. Every PCM frame
# captured while PDM is awake still reaches Opus and the authoritative SD ring.
CONFIG_OMI_VAD_ABS_THRESHOLD=250
CONFIG_OMI_VAD_NOISE_MARGIN=100
CONFIG_OMI_VAD_NOISE_RISE_SHIFT=4
CONFIG_OMI_VAD_NOISE_FALL_SHIFT=2
CONFIG_OMI_VAD_DEBOUNCE_FRAMES=3
CONFIG_OMI_VAD_HOLD_MS=2000
CONFIG_OMI_ENABLE_T5838_AAD=y
CONFIG_OMI_AAD_SETTLE_MS=800
CONFIG_OMI_AAD_IDLE_HOLD_MS=5000
CONFIG_OMI_AAD_CONVERSATION_HOLD_MS=120000
```

## src/main.c
```c
#include <zephyr/kernel.h>
#include <zephyr/logging/log.h>
#include <zephyr/pm/device_runtime.h>
#include <zephyr/shell/shell.h>

#include "lib/core/button.h"
#ifdef CONFIG_OMI_ENABLE_BLACKBOX_DIAGNOSTICS
#include "lib/core/blackbox.h"
#endif
#include "lib/core/codec.h"
#include "lib/core/config.h"
#include "lib/core/feedback.h"
#include "lib/core/haptic.h"
#include "lib/core/led.h"
#include "lib/core/lib/battery/battery.h"
#include "lib/core/mic.h"
#ifdef CONFIG_OMI_ENABLE_MONITOR
#include "lib/core/monitor.h"
#endif
#include "lib/core/settings.h"
#include "lib/core/transport.h"
#ifdef CONFIG_OMI_ENABLE_OFFLINE_STORAGE
#include "lib/core/storage.h"
#endif
#include <hal/nrf_reset.h>

#include "imu.h"
#include "lib/core/sd_card.h"
#include "rtc.h"
#include "spi_flash.h"
#include "wdog_facade.h"

LOG_MODULE_REGISTER(main, CONFIG_LOG_DEFAULT_LEVEL);

#ifdef CONFIG_OMI_ENABLE_BATTERY
#define BATTERY_FULL_THRESHOLD_PERCENT 98 // 98%
extern uint8_t battery_percentage;
#endif
bool is_connected = false;
bool is_charging = false;
bool is_off = false;
bool blink_toggle = false;

static uint32_t take_and_print_reset_reason(void)
{
    uint32_t reas;

    reas = nrf_reset_resetreas_get(NRF_RESET);
    nrf_reset_resetreas_clear(NRF_RESET, reas);

    if (reas & NRF_RESET_RESETREAS_DOG0_MASK) {
        printk("Reset by WATCHDOG\n");
    } else if (reas & NRF_RESET_RESETREAS_NFC_MASK) {
        printk("Wake up by NFC field detect\n");
    } else if (reas & NRF_RESET_RESETREAS_RESETPIN_MASK) {
        printk("Reset by pin-reset\n");
    } else if (reas & NRF_RESET_RESETREAS_SREQ_MASK) {
        printk("Reset by soft-reset\n");
    } else if (reas & NRF_RESET_RESETREAS_LOCKUP_MASK) {
        printk("Reset by CPU LOCKUP\n");
    } else if (reas) {
        printk("Reset by a different source (0x%08X)\n", reas);
    } else {
        printk("Power-on-reset\n");
    }
    return reas;
}

static void codec_handler(uint8_t *data, size_t len)
{
#ifdef CONFIG_OMI_ENABLE_BLACKBOX_DIAGNOSTICS
    blackbox_counter_add(BLACKBOX_COUNTER_AUDIO_FRAME, 1U);
#endif
#ifdef CONFIG_OMI_ENABLE_MONITOR
    monitor_inc_broadcast_audio();
#endif
    int err = broadcast_audio_packets(data, len);
    if (err) {
#ifdef CONFIG_OMI_ENABLE_MONITOR
        monitor_inc_broadcast_audio_failed();
#endif
    }
}

static int mic_handler(int16_t *buffer)
{
#ifdef CONFIG_OMI_ENABLE_BLACKBOX_DIAGNOSTICS
    blackbox_counter_add(BLACKBOX_COUNTER_MIC_BUFFER, 1U);
#endif
#ifdef CONFIG_OMI_ENABLE_MONITOR
    // Track total bytes processed (each sample is 2 bytes)
    monitor_inc_mic_buffer();
#endif

    // Hardware AAD and the software voice gate are handled inside mic.c.
    return codec_receive_pcm(buffer, MIC_BUFFER_SAMPLES);
}

static void boot_led_sequence(void)
{
    // Quick blue pulse = "I'm alive, booting..."
    set_led_blue(true);
    k_msleep(300);
    led_off();
}

static void boot_ready_sequence(void)
{
    const int steps = 50;
    const int delay_ms = 10;

    // Smooth green fade in/out 2 times = "Ready!"
    for (int cycle = 0; cycle < 2; cycle++) {
        // Fade in: ease-in-out
        for (int i = 0; i <= steps; i++) {
            float t = (float) i / steps;
            // Ease-in-out quadratic
            float eased = t < 0.5f ? 2.0f * t * t : 1.0f - 2.0f * (1.0f - t) * (1.0f - t);
            uint8_t level = (uint8_t) (eased * 50.0f);
            set_led_pwm(LED_GREEN, level);
            k_msleep(delay_ms);
        }

        // Fade out: ease-in-out
        for (int i = 0; i <= steps; i++) {
            float t = (float) i / steps;
            float eased = t < 0.5f ? 2.0f * t * t : 1.0f - 2.0f * (1.0f - t) * (1.0f - t);
            uint8_t level = (uint8_t) ((1.0f - eased) * 70.0f);
            set_led_pwm(LED_GREEN, level);
            k_msleep(delay_ms);
        }
    }
    k_msleep(10);
    led_off();
    k_msleep(10);
}

void set_led_state()
{
    // If device is off, turn off all LEDs immediately
    if (is_off) {
        led_off();
        return;
    }

#ifdef CONFIG_OMI_ENABLE_OFFLINE_STORAGE
    // If RTC not synced, blink red to warn user to connect phone app
    if (!rtc_is_valid()) {
        set_led_green(is_charging);
        set_led_blue(!blink_toggle && is_connected);
        set_led_red(blink_toggle);
        blink_toggle = !blink_toggle;
        return;
    }
#endif

    bool green = false;
    bool blue = false;
    bool red = false;

    if (is_charging) {
#ifdef CONFIG_OMI_ENABLE_BATTERY
        // Solid green if battery is full (>= BATTERY_FULL_THRESHOLD_PERCENT)
        if (battery_percentage >= BATTERY_FULL_THRESHOLD_PERCENT) {
            green = true;
        } else
#endif
        {
            green = blink_toggle;
            blue = !blink_toggle && is_connected;
            red = !blink_toggle && !is_connected;
            blink_toggle = !blink_toggle;
        }
    } else {
        blue = is_connected;
        red = !is_connected;
    }

    set_led_green(green);
    set_led_blue(blue);
    set_led_red(red);
}

static int suspend_unused_modules(void)
{
    int err = flash_off();
    if (err) {
        LOG_ERR("Can not suspend the spi flash module: %d", err);
    }

    return 0;
}

int main(void)
{
    int ret;
    printk("Starting omi ...\n");

    // Capture reset provenance before clearing the hardware latch.
    uint32_t reset_reason = take_and_print_reset_reason();

    // Initialize watchdog first to catch any early freezes
    ret = watchdog_init();
    if (ret) {
        LOG_WRN("Watchdog init failed (err %d), continuing without watchdog", ret);
    }

    // Initialize Haptic driver first; this is building up for future of omi turn on sequence - long press to turn on
    // instead of short press
#ifdef CONFIG_OMI_ENABLE_HAPTIC
    ret = haptic_init();
    if (ret) {
        LOG_ERR("Failed to initialize Haptic driver (err %d)", ret);
        error_haptic();
        // Non-critical, continue boot
    } else {
        LOG_INF("Haptic driver initialized");
        play_haptic_milli(100);
    }
#endif

    // Initialize LEDs
    LOG_INF("Initializing LEDs...\n");

    ret = led_start();
    if (ret) {
        LOG_ERR("Failed to initialize LEDs (err %d)", ret);
        error_led_driver();
        return ret;
    }

    // Suspend unused modules
    LOG_PRINTK("\n");
    LOG_INF("Suspending unused modules...\n");
    ret = suspend_unused_modules();
    if (ret) {
        LOG_ERR("Failed to suspend unused modules (err %d)", ret);
        ret = 0;
    }

    // Initialize settings
    LOG_INF("Initializing settings...\n");
    int setting_ret = app_settings_init();
    if (setting_ret) {
        LOG_ERR("Failed to initialize settings (err %d)", setting_ret);
    }

#ifdef CONFIG_OMI_ENABLE_BLACKBOX_DIAGNOSTICS
    uint32_t blackbox_boot_count = setting_ret ? 1U : app_settings_record_blackbox_boot(reset_reason);
    (void) blackbox_init(reset_reason, blackbox_boot_count);
#endif

    // Initialize RTC from saved epoch
    init_rtc();
    if (!rtc_is_valid()) {
        LOG_WRN("UTC time not synchronized yet");
    }

    /*
     * Mixed reset causes are not trusted. A watchdog/soft/pin reset that also
     * inherited OFF must fail closed and wait for live synchronization.
     */
    bool verified_system_off_wake = reset_reason == NRF_RESET_RESETREAS_OFF_MASK;
    (void) lsm6dsl_time_boot_adjust_rtc(verified_system_off_wake);

#ifdef CONFIG_OMI_ENABLE_MONITOR
    // Initialize monitoring system
    LOG_INF("Initializing monitoring system...\n");
    ret = monitor_init();
    if (ret) {
        LOG_ERR("Failed to initialize monitoring system (err %d)", ret);
    }
#endif

    if (setting_ret) {
        error_settings();
        app_settings_save_dim_ratio(30);
    }

    // Initialize battery
#ifdef CONFIG_OMI_ENABLE_BATTERY
    ret = battery_init();
    if (ret) {
        LOG_ERR("Battery init failed (err %d)", ret);
        error_battery_init();
        return ret;
    }

    ret = battery_charge_start();
    if (ret) {
        LOG_ERR("Battery failed to start (err %d)", ret);
        error_battery_charge();
        return ret;
    }
    LOG_INF("Battery initialized");
#endif

    // Initialize button
#ifdef CONFIG_OMI_ENABLE_BUTTON
    ret = button_init();
    if (ret) {
        LOG_ERR("Failed to initialize Button (err %d)", ret);
        error_button();
        return ret;
    }
    LOG_INF("Button initialized");
    activate_button_work();
#endif

    // SD Card
    ret = app_sd_init();
    if (ret) {
        LOG_ERR("Failed to initialize SD Card (err %d)", ret);
        error_sd_card();
        return ret;
    }

#ifdef CONFIG_OMI_ENABLE_OFFLINE_STORAGE
    // Initialize storage service for offline audio
    ret = storage_init();
    if (ret) {
        LOG_ERR("Failed to initialize storage service (err %d)", ret);
        error_storage();
        // Non-critical, continue boot
    } else {
        LOG_INF("Storage service initialized");
    }
#endif

    // Indicate transport initialization
    LOG_PRINTK("\n");
    LOG_INF("Initializing transport...\n");

    // Start transport
    int transportErr;
    transportErr = transport_start();
    if (transportErr) {
        LOG_ERR("Failed to start transport (err %d)", transportErr);
        error_transport();
        return transportErr;
    }

    // Initialize codec
    LOG_INF("Initializing codec...\n");

    // Set codec callback
    set_codec_callback(codec_handler);
    ret = codec_start();
    if (ret) {
        LOG_ERR("Failed to start codec: %d", ret);
        error_codec();
        return ret;
    }

    // Initialize microphone
    LOG_INF("Initializing microphone...\n");
    set_mic_callback(mic_handler);
    ret = mic_start();
    if (ret) {
        LOG_ERR("Failed to start microphone: %d", ret);
        error_microphone();
        return ret;
    }
    // Hardware AAD (T5838) is started inside mic_start().

    LOG_INF("Device initialized successfully\n");

    while (1) {
        watchdog_feed();
#ifdef CONFIG_OMI_ENABLE_BLACKBOX_DIAGNOSTICS
        blackbox_set_sd_state(is_sd_on(), sd_is_ready(), (uint8_t) sd_storage_health());
#endif
#ifdef CONFIG_OMI_ENABLE_MONITOR
        monitor_log_metrics();
#endif

        set_led_state();
        k_msleep(1000);
    }

    printk("Exiting omi...");
    return 0;
}
```

## src/settings.c
```c
#include "lib/core/settings.h"

#include <string.h>
#include <zephyr/kernel.h>
#include <zephyr/logging/log.h>
#include <zephyr/settings/settings.h>

#include "lib/core/ring_transfer_integrity.h"

LOG_MODULE_REGISTER(app_settings, CONFIG_LOG_DEFAULT_LEVEL);

// Default values if not found in flash
#define DEFAULT_DIM_LIGHT_RATIO 50
#define DEFAULT_MIC_GAIN 6

// In-memory cache for the settings
static uint8_t dim_light_ratio = DEFAULT_DIM_LIGHT_RATIO;
static uint8_t mic_gain = DEFAULT_MIC_GAIN;
static struct rtc_time rtc_timestamp = {0};
static uint64_t rtc_epoch = 0;
static app_sd_ring_quarantine_t sd_ring_quarantine = {0};
static int sd_ring_quarantine_load_error;

struct blackbox_boot_record {
    uint32_t version;
    uint32_t boot_count;
    uint32_t reset_reason;
    uint32_t record_crc32;
};

#define BLACKBOX_BOOT_RECORD_VERSION 1U
static struct blackbox_boot_record blackbox_boot_record;

#define SD_RING_QUARANTINE_VERSION 2U
struct sd_ring_quarantine_record {
    uint32_t version;
    uint32_t batch_packets;
    uint64_t affected_start_seq;
    uint64_t replacement_start_seq;
    uint64_t attempted_write_seq;
    uint64_t metadata_generation;
    uint64_t baseline_read_seq;
    uint64_t baseline_write_seq;
    uint64_t baseline_dropped_packets;
    uint32_t capacity_packets;
    uint32_t preimage_crc32;
    uint32_t record_crc32;
} __packed;

struct lsm6dsl_time_base {
    uint64_t epoch_s;
    uint32_t ts;
    uint32_t reserved;
};

static struct lsm6dsl_time_base lsm6dsl_time_base = {0};

static int settings_set(const char *name, size_t len, settings_read_cb read_cb, void *cb_arg)
{
    const char *next;
    int rc;

    if (settings_name_steq(name, "dim_ratio", &next) && !next) {
        if (len != sizeof(dim_light_ratio)) {
            return -EINVAL;
        }
        rc = read_cb(cb_arg, &dim_light_ratio, sizeof(dim_light_ratio));
        if (rc >= 0) {
            LOG_INF("Loaded dim_ratio: %u", dim_light_ratio);
            return 0;
        }
        return rc;
    }

    if (settings_name_steq(name, "mic_gain", &next) && !next) {
        if (len != sizeof(mic_gain)) {
            return -EINVAL;
        }
        rc = read_cb(cb_arg, &mic_gain, sizeof(mic_gain));
        if (rc >= 0) {
            LOG_INF("Loaded mic_gain: %u", mic_gain);
            return 0;
        }
        return rc;
    }

    if (settings_name_steq(name, "rtc_timestamp", &next) && !next) {
        if (len != sizeof(rtc_timestamp)) {
            return -EINVAL;
        }
        rc = read_cb(cb_arg, &rtc_timestamp, sizeof(rtc_timestamp));
        if (rc >= 0) {
            LOG_INF("Loaded rtc_timestamp");
            return 0;
        }
        return rc;
    }

    if (settings_name_steq(name, "rtc_epoch", &next) && !next) {
        /* Backward compatibility: older builds may have stored epoch as u32. */
        if (len == sizeof(rtc_epoch)) {
            rc = read_cb(cb_arg, &rtc_epoch, sizeof(rtc_epoch));
            if (rc >= 0) {
                LOG_INF("Loaded rtc_epoch=%llu", rtc_epoch);
                return 0;
            }
            return rc;
        }

        if (len == sizeof(uint32_t)) {
            uint32_t epoch_u32 = 0;
            rc = read_cb(cb_arg, &epoch_u32, sizeof(epoch_u32));
            if (rc >= 0) {
                rtc_epoch = (uint64_t) epoch_u32;
                LOG_INF("Loaded rtc_epoch(u32)=%u -> %llu", epoch_u32, rtc_epoch);
                return 0;
            }
            return rc;
        }

        LOG_WRN("rtc_epoch size mismatch: len=%u expected=%u (or legacy %u)",
                (unsigned) len,
                (unsigned) sizeof(rtc_epoch),
                (unsigned) sizeof(uint32_t));
        return -EINVAL;
    }

    if (settings_name_steq(name, "lsm6dsl_time_base", &next) && !next) {
        if (len == sizeof(lsm6dsl_time_base)) {
            rc = read_cb(cb_arg, &lsm6dsl_time_base, sizeof(lsm6dsl_time_base));
            if (rc >= 0) {
                LOG_INF("Loaded lsm6dsl_time_base: epoch_s=%llu ts=0x%08x",
                        lsm6dsl_time_base.epoch_s,
                        lsm6dsl_time_base.ts);
                return 0;
            }
            return rc;
        }

        /* Backward compatibility: older builds may have stored without reserved (12 bytes). */
        if (len == (sizeof(uint64_t) + sizeof(uint32_t))) {
            struct {
                uint64_t epoch_s;
                uint32_t ts;
            } legacy;

            rc = read_cb(cb_arg, &legacy, sizeof(legacy));
            if (rc >= 0) {
                lsm6dsl_time_base.epoch_s = legacy.epoch_s;
                lsm6dsl_time_base.ts = legacy.ts;
                lsm6dsl_time_base.reserved = 0;
                LOG_INF("Loaded lsm6dsl_time_base(legacy): epoch_s=%llu ts=0x%08x", legacy.epoch_s, legacy.ts);
                return 0;
            }
            return rc;
        }

        LOG_WRN("lsm6dsl_time_base size mismatch: len=%u expected=%u (or legacy %u)",
                (unsigned) len,
                (unsigned) sizeof(lsm6dsl_time_base),
                (unsigned) (sizeof(uint64_t) + sizeof(uint32_t)));
        return -EINVAL;
    }

    if (settings_name_steq(name, "sd_ring_quarantine", &next) && !next) {
        struct sd_ring_quarantine_record record;
        if (len != sizeof(record)) {
            sd_ring_quarantine_load_error = -EINVAL;
            return -EINVAL;
        }
        rc = read_cb(cb_arg, &record, sizeof(record));
        if (rc < 0) {
            sd_ring_quarantine_load_error = rc;
            return rc;
        }
        uint32_t stored_crc = record.record_crc32;
        record.record_crc32 = 0U;
        uint32_t computed_crc = ring_transfer_crc32_update(0U, (const uint8_t *) &record, sizeof(record));
        if (record.version != SD_RING_QUARANTINE_VERSION || record.batch_packets == 0U || stored_crc != computed_crc) {
            sd_ring_quarantine_load_error = -EINVAL;
            return -EINVAL;
        }
        sd_ring_quarantine_load_error = 0;
        sd_ring_quarantine.affected_start_seq = record.affected_start_seq;
        sd_ring_quarantine.replacement_start_seq = record.replacement_start_seq;
        sd_ring_quarantine.attempted_write_seq = record.attempted_write_seq;
        sd_ring_quarantine.metadata_generation = record.metadata_generation;
        sd_ring_quarantine.baseline_read_seq = record.baseline_read_seq;
        sd_ring_quarantine.baseline_write_seq = record.baseline_write_seq;
        sd_ring_quarantine.baseline_dropped_packets = record.baseline_dropped_packets;
        sd_ring_quarantine.capacity_packets = record.capacity_packets;
        sd_ring_quarantine.batch_packets = record.batch_packets;
        sd_ring_quarantine.preimage_crc32 = record.preimage_crc32;
        sd_ring_quarantine.active = true;
        LOG_WRN("Loaded SD ring quarantine: affected=%llu replacement=%llu packets=%u",
                record.affected_start_seq,
                record.replacement_start_seq,
                record.batch_packets);
        return 0;
    }

    if (settings_name_steq(name, "blackbox_boot", &next) && !next) {
        struct blackbox_boot_record record;
        if (len != sizeof(record)) {
            return -EINVAL;
        }
        rc = read_cb(cb_arg, &record, sizeof(record));
        if (rc < 0) {
            return rc;
        }
        uint32_t stored_crc = record.record_crc32;
        record.record_crc32 = 0U;
        uint32_t computed_crc = ring_transfer_crc32_update(0U, (const uint8_t *) &record, sizeof(record));
        if (record.version != BLACKBOX_BOOT_RECORD_VERSION || stored_crc != computed_crc) {
            return -EINVAL;
        }
        blackbox_boot_record = record;
        blackbox_boot_record.record_crc32 = stored_crc;
        return 0;
    }

    return -ENOENT;
}

int app_settings_save_rtc_timestamp(struct rtc_time ts)
{
    rtc_timestamp = ts;
    int err = settings_save_one("omi/rtc_timestamp", &rtc_timestamp, sizeof(rtc_timestamp));
    if (err) {
        LOG_ERR("Failed to save rtc_timestamp (err %d)", err);
    } else {
        LOG_INF("Saved rtc_timestamp");
    }
    return err;
}

struct rtc_time app_settings_get_rtc_timestamp(void)
{
    return rtc_timestamp;
}

int app_settings_save_rtc_epoch(uint64_t epoch_s)
{
    rtc_epoch = epoch_s;
    int err = settings_save_one("omi/rtc_epoch", &rtc_epoch, sizeof(rtc_epoch));
    if (err) {
        LOG_ERR("Failed to save rtc_epoch (err %d)", err);
    } else {
        LOG_INF("Saved rtc_epoch");
    }
    return err;
}

uint64_t app_settings_get_rtc_epoch(void)
{
    return rtc_epoch;
}

int app_settings_save_lsm6dsl_time_base(uint64_t epoch_s, uint32_t imu_timestamp)
{
    lsm6dsl_time_base.epoch_s = epoch_s;
    lsm6dsl_time_base.ts = imu_timestamp;
    lsm6dsl_time_base.reserved = 0;

    int err = settings_save_one("omi/lsm6dsl_time_base", &lsm6dsl_time_base, sizeof(lsm6dsl_time_base));
    if (err) {
        LOG_ERR("Failed to save lsm6dsl_time_base (err %d)", err);
    } else {
        LOG_INF("Saved lsm6dsl_time_base");
    }
    return err;
}

int app_settings_get_lsm6dsl_time_base(uint64_t *epoch_s, uint32_t *imu_timestamp)
{
    if (epoch_s == NULL || imu_timestamp == NULL) {
        return -EINVAL;
    }
    *epoch_s = lsm6dsl_time_base.epoch_s;
    *imu_timestamp = lsm6dsl_time_base.ts;
    return 0;
}

int app_settings_save_sd_ring_quarantine(uint64_t affected_start_seq,
                                         uint64_t replacement_start_seq,
                                         uint64_t attempted_write_seq,
                                         uint64_t metadata_generation,
                                         uint64_t baseline_read_seq,
                                         uint64_t baseline_write_seq,
                                         uint64_t baseline_dropped_packets,
                                         uint32_t capacity_packets,
                                         uint32_t batch_packets,
                                         uint32_t preimage_crc32)
{
    if (batch_packets == 0U) {
        return -EINVAL;
    }

    struct sd_ring_quarantine_record record;
    memset(&record, 0, sizeof(record));
    record.version = SD_RING_QUARANTINE_VERSION;
    record.batch_packets = batch_packets;
    record.affected_start_seq = affected_start_seq;
    record.replacement_start_seq = replacement_start_seq;
    record.attempted_write_seq = attempted_write_seq;
    record.metadata_generation = metadata_generation;
    record.baseline_read_seq = baseline_read_seq;
    record.baseline_write_seq = baseline_write_seq;
    record.baseline_dropped_packets = baseline_dropped_packets;
    record.capacity_packets = capacity_packets;
    record.preimage_crc32 = preimage_crc32;
    record.record_crc32 = ring_transfer_crc32_update(0U, (const uint8_t *) &record, sizeof(record));
    int err = settings_save_one("omi/sd_ring_quarantine", &record, sizeof(record));
    if (err) {
        LOG_ERR("Failed to save SD ring quarantine (err %d)", err);
        return err;
    }

    sd_ring_quarantine.affected_start_seq = affected_start_seq;
    sd_ring_quarantine.replacement_start_seq = replacement_start_seq;
    sd_ring_quarantine.attempted_write_seq = attempted_write_seq;
    sd_ring_quarantine.metadata_generation = metadata_generation;
    sd_ring_quarantine.baseline_read_seq = baseline_read_seq;
    sd_ring_quarantine.baseline_write_seq = baseline_write_seq;
    sd_ring_quarantine.baseline_dropped_packets = baseline_dropped_packets;
    sd_ring_quarantine.capacity_packets = capacity_packets;
    sd_ring_quarantine.batch_packets = batch_packets;
    sd_ring_quarantine.preimage_crc32 = record.preimage_crc32;
    sd_ring_quarantine.active = true;
    sd_ring_quarantine_load_error = 0;
    return 0;
}

int app_settings_clear_sd_ring_quarantine(void)
{
    int err = settings_delete("omi/sd_ring_quarantine");
    if (err && err != -ENOENT) {
        LOG_ERR("Failed to clear SD ring quarantine (err %d)", err);
        return err;
    }

    memset(&sd_ring_quarantine, 0, sizeof(sd_ring_quarantine));
    sd_ring_quarantine_load_error = 0;
    return 0;
}

app_sd_ring_quarantine_t app_settings_get_sd_ring_quarantine(void)
{
    return sd_ring_quarantine;
}

int app_settings_get_sd_ring_quarantine_load_error(void)
{
    return sd_ring_quarantine_load_error;
}

SETTINGS_STATIC_HANDLER_DEFINE(app_settings, "omi", NULL, settings_set, NULL, NULL);

int app_settings_init(void)
{
    int err = settings_subsys_init();
    if (err) {
        LOG_ERR("Failed to initialize settings subsystem (err %d)", err);
        return err;
    }

    /*
     * Load only app-owned settings here.
     * BT-side settings_load() is done later in transport_start() after
     * bt_enable(), which is the correct ordering.
     */
    err = settings_load_subtree("omi");
    if (err && err != -ENOENT) {
        LOG_ERR("Failed to load app settings (err %d)", err);
    }

    LOG_INF("Settings initialized. dim_ratio=%u mic_gain=%u rtc_epoch=%llu lsm6_base_epoch=%llu lsm6_base_ts=0x%08x",
            dim_light_ratio,
            mic_gain,
            rtc_epoch,
            lsm6dsl_time_base.epoch_s,
            lsm6dsl_time_base.ts);
    return (err == -ENOENT) ? 0 : err;
}

int app_settings_save_dim_ratio(uint8_t new_ratio)
{
    dim_light_ratio = new_ratio;
    int err = settings_save_one("omi/dim_ratio", &dim_light_ratio, sizeof(dim_light_ratio));
    if (err) {
        LOG_ERR("Failed to save dim_ratio (err %d)", err);
    } else {
        LOG_INF("Saved dim_ratio: %u", dim_light_ratio);
    }
    return err;
}

uint8_t app_settings_get_dim_ratio(void)
{
    return dim_light_ratio;
}

int app_settings_save_mic_gain(uint8_t new_gain)
{
    mic_gain = new_gain;
    int err = settings_save_one("omi/mic_gain", &mic_gain, sizeof(mic_gain));
    if (err) {
        LOG_ERR("Failed to save mic_gain (err %d)", err);
    } else {
        LOG_INF("Saved mic_gain: %u", mic_gain);
    }
    return err;
}

uint8_t app_settings_get_mic_gain(void)
{
    return mic_gain;
}

uint32_t app_settings_record_blackbox_boot(uint32_t reset_reason)
{
    struct blackbox_boot_record record = {
        .version = BLACKBOX_BOOT_RECORD_VERSION,
        .boot_count = blackbox_boot_record.boot_count + 1U,
        .reset_reason = reset_reason,
        .record_crc32 = 0U,
    };
    if (record.boot_count == 0U) {
        record.boot_count = 1U;
    }
    record.record_crc32 = ring_transfer_crc32_update(0U, (const uint8_t *) &record, sizeof(record));
    int err = settings_save_one("omi/blackbox_boot", &record, sizeof(record));
    if (err == 0) {
        blackbox_boot_record = record;
    }
    return record.boot_count;
}
```
